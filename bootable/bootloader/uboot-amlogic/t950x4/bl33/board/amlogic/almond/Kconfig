## kernel/amlogic/r311/arch/arm64/configs/burgundy_debug_defconfig
```kconfig
CONFIG_SYSVIPC=y
CONFIG_POSIX_MQUEUE=y
CONFIG_AUDIT=y
CONFIG_NO_HZ=y
CONFIG_HIGH_RES_TIMERS=y
CONFIG_BSD_PROCESS_ACCT=y
CONFIG_TASKSTATS=y
CONFIG_TASK_DELAY_ACCT=y
CONFIG_TASK_XACCT=y
CONFIG_TASK_IO_ACCOUNTING=y
CONFIG_IKCONFIG=y
CONFIG_IKCONFIG_PROC=y
CONFIG_LOG_BUF_SHIFT=18
CONFIG_CGROUPS=y
CONFIG_CPUSETS=y
CONFIG_CGROUP_DEBUG=y
CONFIG_CGROUP_FREEZER=y
CONFIG_CGROUP_CPUACCT=y
CONFIG_RESOURCE_COUNTERS=y
CONFIG_CGROUP_SCHED=y
CONFIG_RT_GROUP_SCHED=y
CONFIG_BLK_DEV_INITRD=y
CONFIG_PANIC_TIMEOUT=5
CONFIG_EMBEDDED=y
# CONFIG_COMPAT_BRK is not set
CONFIG_SYSTEM_TRUSTED_KEYRING=y
CONFIG_PROFILING=y
CONFIG_JUMP_LABEL=y
CONFIG_MODULES=y
CONFIG_MODULE_UNLOAD=y
CONFIG_DEFAULT_NOOP=y
CONFIG_ARCH_VEXPRESS=y
CONFIG_SMP=y
CONFIG_SCHED_MC=y
CONFIG_PREEMPT=y
CONFIG_ARMV7_COMPAT=y
CONFIG_DEFAULT_MMAP_MIN_ADDR=32768
CONFIG_CMA=y
CONFIG_CMA_SIZE_MBYTES=96
CONFIG_CMA_SIZE_SEL_MBYTES=y
CONFIG_ZSMALLOC=y
CONFIG_SECCOMP=y
CONFIG_CMDLINE="console=ttyAMA0"
CONFIG_BINFMT_MISC=y
CONFIG_COMPAT=y
CONFIG_CPU_FREQ=y
CONFIG_CPU_FREQ_DEFAULT_GOV_PERFORMANCE=y
CONFIG_CPU_FREQ_GOV_INTERACTIVE=y
CONFIG_ARM_BIG_LITTLE_CPUFREQ=y
CONFIG_ARM_SCPI_CPUFREQ=y
CONFIG_AMLOGIC_CPUFREQ_PERFBOOST=y
CONFIG_CPU_IDLE=y
# CONFIG_CPU_IDLE_GOV_LADDER is not set
CONFIG_ARM64_CPUIDLE=y
CONFIG_NET=y
CONFIG_PACKET=y
CONFIG_PACKET_DIAG=y
CONFIG_UNIX=y
CONFIG_UNIX_DIAG=y
CONFIG_XFRM_USER=y
CONFIG_NET_KEY=y
CONFIG_NET_KEY_MIGRATE=y
CONFIG_INET=y
CONFIG_IP_MULTICAST=y
CONFIG_IP_ADVANCED_ROUTER=y
CONFIG_IP_MULTIPLE_TABLES=y
CONFIG_IP_PNP=y
CONFIG_IP_PNP_DHCP=y
CONFIG_IP_PNP_BOOTP=y
CONFIG_IP_PNP_RARP=y
CONFIG_NET_IPIP=y
CONFIG_SYN_COOKIES=y
CONFIG_INET_ESP=y
# CONFIG_INET_LRO is not set
CONFIG_INET_DIAG_DESTROY=y
CONFIG_IPV6=y
CONFIG_IPV6_ROUTER_PREF=y
CONFIG_IPV6_ROUTE_INFO=y
CONFIG_IPV6_OPTIMISTIC_DAD=y
CONFIG_INET6_AH=y
CONFIG_INET6_ESP=y
CONFIG_INET6_IPCOMP=y
CONFIG_IPV6_MIP6=y
CONFIG_IPV6_TUNNEL=y
CONFIG_IPV6_MULTIPLE_TABLES=y
CONFIG_NETFILTER=y
CONFIG_NF_CONNTRACK=y
CONFIG_NF_CONNTRACK_EVENTS=y
CONFIG_NF_CT_PROTO_DCCP=y
CONFIG_NF_CT_PROTO_SCTP=y
CONFIG_NF_CT_PROTO_UDPLITE=y
CONFIG_NF_CONNTRACK_AMANDA=y
CONFIG_NF_CONNTRACK_FTP=y
CONFIG_NF_CONNTRACK_H323=y
CONFIG_NF_CONNTRACK_IRC=y
CONFIG_NF_CONNTRACK_NETBIOS_NS=y
CONFIG_NF_CONNTRACK_PPTP=y
CONFIG_NF_CONNTRACK_SANE=y
CONFIG_NF_CONNTRACK_TFTP=y
CONFIG_NF_CT_NETLINK=y
CONFIG_NETFILTER_XT_TARGET_CLASSIFY=y
CONFIG_NETFILTER_XT_TARGET_CONNMARK=y
CONFIG_NETFILTER_XT_TARGET_IDLETIMER=y
CONFIG_NETFILTER_XT_TARGET_MARK=y
CONFIG_NETFILTER_XT_TARGET_NFLOG=y
CONFIG_NETFILTER_XT_TARGET_NFQUEUE=y
CONFIG_NETFILTER_XT_TARGET_TPROXY=y
CONFIG_NETFILTER_XT_TARGET_TRACE=y
CONFIG_NETFILTER_XT_MATCH_COMMENT=y
CONFIG_NETFILTER_XT_MATCH_CONNBYTES=y
CONFIG_NETFILTER_XT_MATCH_CONNLIMIT=y
CONFIG_NETFILTER_XT_MATCH_CONNMARK=y
CONFIG_NETFILTER_XT_MATCH_CONNTRACK=y
CONFIG_NETFILTER_XT_MATCH_HASHLIMIT=y
CONFIG_NETFILTER_XT_MATCH_HELPER=y
CONFIG_NETFILTER_XT_MATCH_IPRANGE=y
CONFIG_NETFILTER_XT_MATCH_LENGTH=y
CONFIG_NETFILTER_XT_MATCH_LIMIT=y
CONFIG_NETFILTER_XT_MATCH_MAC=y
CONFIG_NETFILTER_XT_MATCH_MARK=y
CONFIG_NETFILTER_XT_MATCH_POLICY=y
CONFIG_NETFILTER_XT_MATCH_PKTTYPE=y
CONFIG_NETFILTER_XT_MATCH_QTAGUID=y
CONFIG_NETFILTER_XT_MATCH_QUOTA=y
CONFIG_NETFILTER_XT_MATCH_QUOTA2=y
CONFIG_NETFILTER_XT_MATCH_QUOTA2_LOG=y
CONFIG_NETFILTER_XT_MATCH_SOCKET=y
CONFIG_NETFILTER_XT_MATCH_STATE=y
CONFIG_NETFILTER_XT_MATCH_STATISTIC=y
CONFIG_NETFILTER_XT_MATCH_STRING=y
CONFIG_NETFILTER_XT_MATCH_TIME=y
CONFIG_NETFILTER_XT_MATCH_U32=y
CONFIG_NF_CONNTRACK_IPV4=y
CONFIG_IP_NF_IPTABLES=y
CONFIG_IP_NF_MATCH_AH=y
CONFIG_IP_NF_MATCH_ECN=y
CONFIG_IP_NF_MATCH_TTL=y
CONFIG_IP_NF_FILTER=y
CONFIG_IP_NF_TARGET_REJECT=y
CONFIG_NF_NAT_IPV4=y
CONFIG_IP_NF_TARGET_MASQUERADE=y
CONFIG_IP_NF_TARGET_NETMAP=y
CONFIG_IP_NF_TARGET_REDIRECT=y
CONFIG_IP_NF_MANGLE=y
CONFIG_IP_NF_RAW=y
CONFIG_IP_NF_ARPTABLES=y
CONFIG_IP_NF_ARPFILTER=y
CONFIG_IP_NF_ARP_MANGLE=y
CONFIG_NF_CONNTRACK_IPV6=y
CONFIG_IP6_NF_IPTABLES=y
CONFIG_IP6_NF_MATCH_RPFILTER=y
CONFIG_IP6_NF_FILTER=y
CONFIG_IP6_NF_TARGET_REJECT=y
CONFIG_IP6_NF_MANGLE=y
CONFIG_IP6_NF_RAW=y
CONFIG_NF_NAT_IPV6=y
CONFIG_IP6_NF_TARGET_MASQUERADE=y
CONFIG_IP6_NF_TARGET_NPT=y
CONFIG_L2TP=y
CONFIG_L2TP_DEBUGFS=y
CONFIG_L2TP_V3=y
CONFIG_L2TP_IP=y
CONFIG_L2TP_ETH=y
CONFIG_BRIDGE=y
# CONFIG_BRIDGE_IGMP_SNOOPING is not set
CONFIG_PHONET=y
CONFIG_NET_SCHED=y
CONFIG_NET_SCH_HTB=y
CONFIG_NET_SCH_INGRESS=y
CONFIG_NET_CLS_U32=y
CONFIG_NET_EMATCH=y
CONFIG_NET_EMATCH_U32=y
CONFIG_NET_CLS_ACT=y
CONFIG_NET_ACT_POLICE=y
CONFIG_NET_ACT_GACT=y
CONFIG_NET_ACT_MIRRED=y
CONFIG_BT=y
CONFIG_WIRELESS_EXT=y
CONFIG_WEXT_PRIV=y
CONFIG_CFG80211=m
CONFIG_CFG80211_INTERNAL_REGDB=y
CONFIG_CFG80211_WEXT=y
CONFIG_CFG80211_11D_DISABLED=y
CONFIG_MAC80211=m
CONFIG_RFKILL=y
CONFIG_MESON_TIMER=y
CONFIG_MESON_BC_TIMER=y
CONFIG_AM_UART=y
CONFIG_PRINTK_NOBLOCK_MODE=y
CONFIG_AML_CPU_VERSION=y
CONFIG_AML_MESON64_VERSION=y
CONFIG_AMLOGIC_IOMAP=y
CONFIG_PINCTRL_AMLOGIC=y
CONFIG_AMLOGIC_USB=y
CONFIG_USB_DWC_OTG_HCD=m
CONFIG_I2C_AML=y
CONFIG_I2C_SLAVE_AML=y
CONFIG_AMLOGIC_PWM=y
CONFIG_PWM_MESON=y
CONFIG_AML_VRTC=y
# CONFIG_AM_IRBLASTER is not set
CONFIG_AML_REG_ACCESS=y
CONFIG_MMC_AML=y
CONFIG_AML_VPU=y
CONFIG_AMLOGIC_ION=y
CONFIG_AML_DISPLAY=y
CONFIG_AM_TV_OUTPUT=y
CONFIG_AML_VOUT_FRAMERATE_AUTOMATION=y
CONFIG_AM_FB=y
CONFIG_FB_OSD_SUPPORT_SYNC_FENCE=y
CONFIG_FB_OSD_VSYNC_RDMA=y
CONFIG_FB_OSD2_ENABLE=y
CONFIG_FB_OSD2_CURSOR=y
CONFIG_AM_LOGO=y
CONFIG_AML_LCD=y
CONFIG_AML_LCD_TV=y
#CONFIG_AML_LCD_TABLET is not set
CONFIG_AML_LCD_EXTERN=y
#CONFIG_AML_LCD_EXTERN_I2C_T5800Q is not set
#CONFIG_AML_LCD_EXTERN_I2C_DLPC3439 is not set
CONFIG_AML_BACKLIGHT=y
#CONFIG_AML_LOCAL_DIMMING is not set
CONFIG_AMLOGIC_LED=y
#CONFIG_AML_LED_SYS is not set
CONFIG_AML_LED_PWM=y
CONFIG_AML_LED_TRIGGER_BREATHE=y
#CONFIG_AML_LED_TRIGGER_SCPI is not set
#CONFIG_AML_LED_TRIGGER_SCPISTOP is not set
#CONFIG_AML_LED_TRIGGER_DISTURB is not set
CONFIG_AML_CANVAS=y
CONFIG_AMLOGIC_CLK=y
CONFIG_AMLOGIC_SEC=y
CONFIG_AMLOGIC_SECURITY_KEY=y
CONFIG_VSYNC_RDMA=y
CONFIG_AM_VIDEO=y
CONFIG_GE2D_KEEP_FRAME=y
CONFIG_AM_VDEC_MMPEG4=y
CONFIG_AM_VDEC_MH264=y
CONFIG_AM_VDEC_MMJPEG=y
CONFIG_AM_ENCODER=y
CONFIG_AM_SUBTITLE=y
CONFIG_AM_HEVCENC=y
CONFIG_DEINTERLACE=y
CONFIG_AML_VFM=y
CONFIG_EFUSE=y
CONFIG_KEY_MANAGE=y
CONFIG_POST_PROCESS_MANAGER=y
CONFIG_POST_PROCESS_MANAGER_PPSCALER=y
CONFIG_AM_WIFI=y
CONFIG_AML_POWER_RESET=y
CONFIG_GXBB_POWER_RESET=n
CONFIG_BLANCHE_POWER_RESET=y
CONFIG_AML_POWER_SUPPORT=y
CONFIG_AMLOGIC_BOARD_HAS_AC=y
CONFIG_BT_DEVICE=y
# CONFIG_BLUESLEEP is not set
CONFIG_AMLOGIC_IONVIDEO=y
CONFIG_V4L_AMLOGIC_VIDEO=y
CONFIG_V4L_AMLOGIC_VIDEO2=y
CONFIG_TVIN=y
CONFIG_TVIN_VDIN=y
CONFIG_TVIN_AFE=y
CONFIG_TVIN_VBI=y
CONFIG_TVIN_AVIN_DETECT=y
CONFIG_TVIN_HDMI=y
CONFIG_VIUIN=y
CONFIG_AM_VECM=y
CONFIG_AM_INPUT=y
CONFIG_AM_SARADC=y
CONFIG_AMLOGIC_REMOTE=y
CONFIG_MESON_REMOTE=y
CONFIG_MESON_INPUT_KEYBOARD=y
CONFIG_5_WAY_KEYS=y
CONFIG_ADC_KEYPADS_AM=y
CONFIG_AML_GPIO_KEY=y
CONFIG_AMLOGIC_AVIN_DETECT=y
CONFIG_AML_AVIN_DETECT=y
CONFIG_AMLOGIC_SCPI_CPUFREQ=y
CONFIG_MESON_SUSPEND=y
CONFIG_GXBB_SUSPEND=y
CONFIG_AM_DVB=y
CONFIG_AM_ATVDEMOD=y
CONFIG_AM_DTVDEMOD=y
CONFIG_MESON_MHU_MBOX=y
CONFIG_AML_TEMP_SENSOR=y
CONFIG_AUDIO_DATA=y
CONFIG_AML_WDT=y
CONFIG_GX_WDT=y
CONFIG_AMLOGIC_SPICC_MASTER=y
CONFIG_AMLOGIC_JTAG=y
CONFIG_AML_JTAG_SETUP=y
CONFIG_AMLOGIC_CPU_INFO=y
CONFIG_DEFEND_IMG=y
CONFIG_AML_AO_CEC=y
CONFIG_CRYPTO_AML=y
CONFIG_AMLOGIC_TEE=y
CONFIG_UEVENT_HELPER_PATH=""
CONFIG_AMLOGIC_DEBUG=y
CONFIG_AMLOGIC_DEBUG_LOCKUP=y
CONFIG_DMA_CMA=y
CONFIG_CONNECTOR=y
CONFIG_ZRAM=y
CONFIG_ZRAM_LZ4_COMPRESS=y
CONFIG_BLK_DEV_LOOP=y
CONFIG_VIRTIO_BLK=y
CONFIG_UID_STAT=y
CONFIG_SCSI=y
CONFIG_BLK_DEV_SD=y
CONFIG_BLK_DEV_SR=y
CONFIG_SCSI_MULTI_LUN=y
CONFIG_MD=y
CONFIG_BLK_DEV_DM=y
CONFIG_DM_CRYPT=y
CONFIG_DM_VERITY=y
CONFIG_DM_UEVENT=y
CONFIG_DM_VERITY_FEC=y
CONFIG_NETDEVICES=y
CONFIG_TUN=y
#CONFIG_SMC91X=y
#CONFIG_SMSC911X=y
CONFIG_STMMAC_ETH=y
CONFIG_DWMAC_MESON=y
CONFIG_AMLOGIC_PHY=y
#CONFIG_ICPLUS_PHY=y
#CONFIG_REALTEK_PHY=y
CONFIG_PPP=y
CONFIG_PPP_BSDCOMP=y
CONFIG_PPP_DEFLATE=y
CONFIG_PPP_FILTER=y
CONFIG_PPP_MPPE=y
CONFIG_PPP_MULTILINK=y
CONFIG_PPPOE=y
CONFIG_PPPOL2TP=y
CONFIG_PPPOLAC=y
CONFIG_PPPOPNS=y
CONFIG_PPP_ASYNC=y
CONFIG_USB_USBNET=y
CONFIG_INPUT_POLLDEV=y
CONFIG_INPUT_EVDEV=y
CONFIG_INPUT_JOYSTICK=y
CONFIG_JOYSTICK_XPAD=y
CONFIG_JOYSTICK_XPAD_FF=y
CONFIG_JOYSTICK_XPAD_LEDS=y
CONFIG_INPUT_MISC=y
CONFIG_INPUT_UINPUT=y
CONFIG_SERIO_AMBAKMI=y
# CONFIG_DEVMEM is not set
# CONFIG_DEVKMEM is not set
CONFIG_SERIAL_AMBA_PL011=y
CONFIG_SERIAL_AMBA_PL011_CONSOLE=y
CONFIG_SUPPORT_SYSRQ=y
CONFIG_MAGIC_SYSRQ=y
CONFIG_HW_RANDOM=y
CONFIG_I2C_GPIO=y
CONFIG_GPIO_SYSFS=y
CONFIG_THERMAL=y
CONFIG_THERMAL_WRITABLE_TRIPS=y
CONFIG_THERMAL_DEFAULT_GOV_POWER_ALLOCATOR=y
CONFIG_CPU_THERMAL=y
CONFIG_DEVFREQ_THERMAL=y
CONFIG_CPUCORE_THERMAL=y
CONFIG_GPU_THERMAL=y
CONFIG_GPUCORE_THERMAL=y
CONFIG_REGULATOR=y
CONFIG_MEDIA_SUPPORT=y
#CONFIG_MEDIA_CAMERA_SUPPORT=y
CONFIG_MEDIA_DIGITAL_TV_SUPPORT=y
CONFIG_MEDIA_RC_SUPPORT=y
CONFIG_MEDIA_USB_SUPPORT=y
#CONFIG_USB_VIDEO_CLASS=y
CONFIG_FB_ARMCLCD=y
CONFIG_LOGO=y
# CONFIG_LOGO_LINUX_MONO is not set
# CONFIG_LOGO_LINUX_VGA16 is not set
CONFIG_SND_USB_AUDIO=y
CONFIG_SND_AML_M8_SOC=y
CONFIG_SND_AML_M8=y
CONFIG_SND_AML_SPLIT_MODE=y
CONFIG_HID=y
CONFIG_HID_BATTERY_STRENGTH=y
CONFIG_HID_FTV_BLEREMOTE=y
CONFIG_HIDRAW=y
CONFIG_UHID=y
CONFIG_USB_HIDDEV=y
#
# Special HID drivers
#
CONFIG_HID_DIA_REMOTE=y
CONFIG_HID_APPLE=y
CONFIG_HID_ELECOM=y
CONFIG_HID_TIVO=y
CONFIG_HID_ICADE=y
CONFIG_HID_MICROSOFT=y
CONFIG_HID_MAGICMOUSE=y
CONFIG_HID_SONY=y
CONFIG_HID_WACOM=y
CONFIG_HID_WIIMOTE=y
CONFIG_HID_A4TECH=y
CONFIG_HID_BELKIN=y
CONFIG_HID_CHERRY=y
CONFIG_HID_CHICONY=y
CONFIG_HID_CYPRESS=y
CONFIG_HID_DRAGONRISE=y
CONFIG_HID_EZKEY=y
CONFIG_HID_KYE=y
CONFIG_HID_GYRATION=y
CONFIG_HID_TWINHAN=y
CONFIG_HID_KENSINGTON=y
CONFIG_HID_LOGITECH=y
CONFIG_HID_MONTEREY=y
CONFIG_HID_NTRIG=y
CONFIG_HID_PANTHERLORD=y
CONFIG_HID_PETALYNX=y
CONFIG_HID_SAMSUNG=y
CONFIG_HID_SUNPLUS=y
CONFIG_HID_GREENASIA=y
CONFIG_HID_SMARTJOYPLUS=y
CONFIG_HID_TOPSEED=y
CONFIG_HID_THRUSTMASTER=y
CONFIG_HID_ZEROPLUS=y
CONFIG_USB_XHCI_HCD=y
CONFIG_USB_EHCI_HCD=y
CONFIG_USB_EHCI_HCD_SYNOPSYS=y
CONFIG_USB_OHCI_HCD=y
CONFIG_USB_ACM=y
CONFIG_USB_STORAGE=y
CONFIG_USB_DWC3=m
CONFIG_USB_DWC3_HOST=y
CONFIG_USB_SERIAL=y
CONFIG_USB_ISP1301=y
CONFIG_USB_ULPI=y
CONFIG_AMLOGIC_USB2PHY=y
CONFIG_AMLOGIC_USB3PHY=y
CONFIG_USB_GADGET=y
CONFIG_USB_G_ANDROID=y
CONFIG_MMC_ARMMMCI=y
CONFIG_NEW_LEDS=y
CONFIG_LEDS_CLASS=y
CONFIG_LEDS_PWM=y
CONFIG_LEDS_TRIGGERS=y
CONFIG_LEDS_TRIGGER_TIMER=y
CONFIG_UIO=y
CONFIG_UIO_PDRV_GENIRQ=y
CONFIG_VIRTIO_MMIO=y
CONFIG_ANDROID_BINDER_IPC=y
CONFIG_ASHMEM=y
#CONFIG_ANDROID_LOGGER=y
CONFIG_ANDROID_LOW_MEMORY_KILLER=y
CONFIG_ANDROID_INTF_ALARM_DEV=y
CONFIG_SW_SYNC_USER=y
CONFIG_COMMON_CLK_SCPI=y
CONFIG_PM_DEVFREQ=y
CONFIG_DEVFREQ_GOV_SIMPLE_ONDEMAND=y
#CONFIG_EXT2_FS=y
#CONFIG_EXT2_FS_XATTR=y
#CONFIG_EXT2_FS_POSIX_ACL=y
#CONFIG_EXT2_FS_SECURITY=y
CONFIG_EXT3_FS=y
CONFIG_EXT3_FS_POSIX_ACL=y
CONFIG_EXT3_FS_SECURITY=y
CONFIG_EXT4_FS=y
CONFIG_EXT4_FS_POSIX_ACL=y
CONFIG_EXT4_FS_SECURITY=y
CONFIG_FANOTIFY=y
CONFIG_QUOTA=y
CONFIG_QFMT_V2=y
CONFIG_FUSE_FS=y
CONFIG_MSDOS_FS=y
CONFIG_VFAT_FS=y
#CONFIG_EXFAT_FS=y
CONFIG_NTFS_FS=y
CONFIG_TMPFS=y
CONFIG_TMPFS_POSIX_ACL=y
CONFIG_PSTORE=y
CONFIG_PSTORE_CONSOLE=y
CONFIG_PSTORE_RAM=y
CONFIG_PSTORE_FTRACE=y
#CONFIG_NFS_FS=y
# CONFIG_NFS_V2 is not set
#CONFIG_NFS_V3_ACL=y
#CONFIG_NFS_V4=y
CONFIG_NLS_CODEPAGE_437=y
CONFIG_NLS_ISO8859_1=y
CONFIG_NLS_UTF8=y
CONFIG_PRINTK_TIME=y
CONFIG_DEBUG_INFO=y
CONFIG_SCHEDSTATS=y
CONFIG_TIMER_STATS=y
CONFIG_FTRACE_SYSCALLS=y
CONFIG_STACK_TRACER=y
CONFIG_FUNCTION_PROFILER=y
CONFIG_KGDB=y
CONFIG_KGDB_TESTS=y
CONFIG_AML_USER_FAULT=y
CONFIG_KEYS_DEBUG_PROC_KEYS=y
CONFIG_DEBUG_FS=y
CONFIG_LOCKUP_DETECTOR=y
CONFIG_HARDLOCKUP_DETECTOR=y
CONFIG_HARDLOCKUP_DETECTOR_OTHER_CPU=y
CONFIG_DEBUG_LAST_SCHED_TASK=y
CONFIG_BOOTPARAM_HARDLOCKUP_PANIC=y
CONFIG_BOOTPARAM_HARDLOCKUP_PANIC_VALUE=1
CONFIG_BOOTPARAM_SOFTLOCKUP_PANIC=y
CONFIG_BOOTPARAM_SOFTLOCKUP_PANIC_VALUE=1
CONFIG_SECURITY=y
CONFIG_SECURITYFS=y
CONFIG_SECURITY_PATH=y
CONFIG_LSM_MMAP_MIN_ADDR=0
CONFIG_SECURITY_SELINUX=y
CONFIG_SECURITY_SELINUX_KERN_PERMISSIVE=y
CONFIG_SECURITY_SMACK=y
CONFIG_CRYPTO_CCM=y
CONFIG_CRYPTO_MICHAEL_MIC=y
CONFIG_CRYPTO_TWOFISH=y
CONFIG_CRYPTO_ANSI_CPRNG=y
CONFIG_CRYPTO_USER_API_HASH=y
CONFIG_CRYPTO_USER_API_SKCIPHER=y
CONFIG_ASYMMETRIC_KEY_TYPE=y
CONFIG_ASYMMETRIC_PUBLIC_KEY_SUBTYPE=y
CONFIG_X509_CERTIFICATE_PARSER=y
CONFIG_ARM64_CRYPTO=y
CONFIG_CRYPTO_SHA1_ARM64_CE=y
CONFIG_CRYPTO_SHA2_ARM64_CE=y
CONFIG_CRYPTO_GHASH_ARM64_CE=y
CONFIG_CRYPTO_AES_ARM64_CE=y
CONFIG_CRYPTO_AES_ARM64_CE_CCM=y
CONFIG_CRYPTO_AES_ARM64_CE_BLK=y
CONFIG_CRYPTO_AES_ARM64_NEON_BLK=y
CONFIG_CRC_T10DIF=y
CONFIG_CRC7=y
CONFIG_IDME=y
CONFIG_AMAZON=y
CONFIG_AMAZON_METRICS_LOG=y
CONFIG_AMAZON_MINERVA_METRICS_LOG=y
CONFIG_AMAZON_SIGN_OF_LIFE=y
CONFIG_DYNAMIC_DEBUG=y
CONFIG_KSM=y
CONFIG_AMLOGIC_PRI_BOARD_INFO=y
CONFIG_HZ_300=y
CONFIG_AMZN_CHIP_ID_FORMAT=y
CONFIG_IRQSOFF_TRACER=y
CONFIG_PREEMPT_TRACER=y
CONFIG_LEGACY_PTY_COUNT=32
#
# Lab's USB patches to improve wifi bt USB performance
#
CONFIG_LAB_USB=y
#
# USB STR patch
#
CONFIG_MP_EHCI_PORT_QUICK_RESUME=y
CONFIG_MP_EHCI_QUICK_RESUME_PORT_MASK=0x08
CONFIG_VMAP_STACK=y
CONFIG_MESON_REMOTE_LEARN=y
CONFIG_AM_IRBLASTER=y
CONFIG_SND_SOC_AD82584F=y
CONFIG_AM_ATV_AUTO_SCAN=y
CONFIG_AM_CVBS_PAL_M=y
CONFIG_AM_PRODUCT_ANJALI=y
CONFIG_AM_WOL=y
CONFIG_AM_LVDS_SS=y
CONFIG_AM_ATV_OFFSET=y
CONFIG_AM_ATV_SYNC_SCAN_RANGE=y
CONFIG_AM_VLOCK_MODE=y
CONFIG_AM_ATV_SEARCH_RANGE=y
CONFIG_AM_AV_SECAM_CVD2=y
CONFIG_WOL_POWER=y
CONFIG_AM_ATV_SEARCH_PATCH=y
CONFIG_AM_ATV_CHANGE_SCREEN_SIZE=y
CONFIG_AM_TRY_FORMAT_MAX_AV=y
CONFIG_AM_AV_ADD_CHROME_LOCK_DETECT=y
CONFIG_AM_AV_CH_WHITE_PATTERN_EN=y
CONFIG_AM_HDMI_SCAN_MODE_NODE=y
CONFIG_AM_NEW_PLL_EN=y
CONFIG_AM_PRODUCT_BURGUNDY=y
CONFIG_AM_HDMI_AUDIO_FIFO=y
CONFIG_AM_VBUS_POWER
```

## kernel/amlogic/r311/drivers/amlogic/clk/Kconfig
```kconfig
# Amlogic clock driver


config AMLOGIC_CLK
    bool "Amlogic clock driver  support"
    select COMMON_CLK
    help
      This is the Amlogic Clock  driver

config AM_NEW_PLL_EN
    bool "Amlogic new pll enable"
    default n
    help
        Amlogic new pll enable
```

## kernel/amlogic/r311/drivers/amlogic/debug/Kconfig
```kconfig
config AMLOGIC_DEBUG
    boolean "Amlogic kernel debug"
    default n
    help
        This is Amlogic kernel debug

config AMLOGIC_DEBUG_LOCKUP
    boolean "Amlogic lockup debug"
    depends on LOCKUP_DETECTOR
    depends on BOOTPARAM_HARDLOCKUP_PANIC
    depends on BOOTPARAM_SOFTLOCKUP_PANIC
    depends on AMLOGIC_DEBUG
    default n
    help
        This is Amlogic kernel lockup debug.
        Debug lockup in isr and deadlock with irq disabled.

config AMLOGIC_DEBUG_STACKOVERFLOW
    boolean "Amlogic stack overflow debug"
    depends on AMLOGIC_DEBUG
    default n
    help
        This is Amlogic kernel stack overflow debug.
        Warn when stack usage if bigger than stack_margin.
```
