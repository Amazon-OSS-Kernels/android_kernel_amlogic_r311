## kernel/amlogic/r311/drivers/amlogic/dvb_tv/Kconfig
```kconfig
#
# DVB driver configuration
#

menu "Amlogic DVB driver"

config AM_DVB
	tristate "AMLOGIC DVB driver"
	default n
	select DVB_CORE
	help
		Select to enable AMLogic DVB driver.
		Y: enable
		N: disable
		M: build as module

config AM_ATVDEMOD
	tristate "Amlogic ATVDEMOD device driver"
	default n
	help
	  ATVDEMOD device driver.
		Y: enable
		N: disable
		M: build as module

config AM_ATV_AUTO_SCAN
	tristate "Amlogic ATVDEMOD device driver with ATV AUTO SCAN"
	default n
	depends on AM_ATVDEMOD
	help
	  ATVDEMOD device driver with ATV AUTO SCAN.
		Y: enable
		N: disable
		M: build as module

config AM_ATV_OFFSET
        tristate "Amlogic ATVDEMOD atvdemod_horiz_freq_det_en"
        default n
        depends on AM_ATVDEMOD
        help
          ENABLE atvdemod_horiz_freq_det_en.
                Y: enable
                N: disable
                M: build as module

config AM_DTVDEMOD
	tristate "Amlogic DTVDEMOD device driver"
	default n
	depends on AM_DVB
	help
		DTVDEMOD device driver.
		Y: enable
		N: disable
		M: build as module
menu "AMLOGIC CI Driver"

config AM_CI
	tristate "Amlogic Common Interface driver"
	default n
	depends on AM_DVB
	select AM_PCMCIA
	select AM_SPI
	select AM_CI_CIMAX_USB
	help
		Select to enable Amlogic CI driver.
		Y: enable
		N: disable
		M: build as module
config AM_PCMCIA
	tristate "Amlogic PCMCIA driver"
	default n
	help
		Select to enable Amlogic PCMCIA driver.
		Y: enable
		N: disable
		M: build as module
config AM_SPI
	tristate "Amlogic SPI driver"
	default n
	help
		Select to enable Amlogic SPI driver.
		Y: enable
		N: disable
		M: build as module
config AM_CI_CIMAX_USB
	tristate "usb cimax driver"
	default n
	help
		Y: enable
		N: disable
		M: build as module
endmenu

if !OF

config AMLOGIC_TS0
	bool "Enable TS0"
	default n
	depends on AM_DVB
	help
		Enable TS0.
		Y: enable
		N: disable
		M: build as module
config AMLOGIC_S_TS0
	bool "Serial TS0"
	default n
	depends on AMLOGIC_TS0
	help
		TS0 in serial mode.
		Y: enable
		N: disable
		M: build as module
config AMLOGIC_TS0_INVERT_S2P1_FEC_ERROR
	bool "Invert FEC_ERROR TS0"
	default n
	depends on AMLOGIC_S_TS0
	help
		TS0 FEC_ERROR invert
		Y: enable
		N: disable
		M: build as module
config AMLOGIC_TS0_INVERT_S2P1_FEC_DATA
	bool "Invert FEC_DATA TS0"
	default n
	depends on AMLOGIC_S_TS0
	help
		TS0 FEC_DATA invert
		Y: enable
		N: disable
		M: build as module
config AMLOGIC_TS0_INVERT_S2P1_FEC_SYNC
	bool "Invert FEC_SYNC TS0"
	default n
	depends on AMLOGIC_S_TS0
	help
		TS0 FEC_SYNC invert
		Y: enable
		N: disable
		M: build as module
config AMLOGIC_TS0_INVERT_S2P1_FEC_VALID
	bool "Invert FEC_VALID TS0"
	default n
	depends on AMLOGIC_S_TS0
	help
		TS0 FEC_VALID invert
		Y: enable
		N: disable
		M: build as module
config AMLOGIC_TS0_INVERT_S2P1_FEC_CLK
	bool "Invert FEC_CLK TS0"
	default n
	depends on AMLOGIC_S_TS0
	help
		TS0 FEC_CLK invert
		Y: enable
		N: disable
		M: build as module
config AMLOGIC_TS1
	bool "Enable TS1"
	default n
	depends on AM_DVB
	help
		Enable TS1.
		Y: enable
		N: disable
		M: build as module
config AMLOGIC_S_TS1
	bool "Serial TS1"
	default n
	depends on AMLOGIC_TS1
	help
		TS1 in serial mode.
		Y: enable
		N: disable
		M: build as module
config AMLOGIC_TS1_INVERT_S2P1_FEC_ERROR
	bool "Invert FEC_ERROR TS1"
	default n
	depends on AMLOGIC_S_TS1
	help
		TS1 FEC_ERROR invert
		Y: enable
		N: disable
		M: build as module
config AMLOGIC_TS1_INVERT_S2P1_FEC_DATA
	bool "Invert FEC_DATA TS1"
	default n
	depends on AMLOGIC_S_TS1
	help
		TS1 FEC_DATA invert
		Y: enable
		N: disable
		M: build as module
config AMLOGIC_TS1_INVERT_S2P1_FEC_SYNC
	bool "Invert FEC_SYNC TS1"
	default n
	depends on AMLOGIC_S_TS1
	help
		TS1 FEC_SYNC invert
		Y: enable
		N: disable
		M: build as module
config AMLOGIC_TS1_INVERT_S2P1_FEC_VALID
	bool "Invert FEC_VALID TS1"
	default n
	depends on AMLOGIC_S_TS1
	help
		TS1 FEC_VALID invert
		Y: enable
		N: disable
		M: build as module
config AMLOGIC_TS1_INVERT_S2P1_FEC_CLK
	bool "Invert FEC_CLK TS1"
	default n
	depends on AMLOGIC_S_TS1
	help
		TS1 FEC_CLK invert
		Y: enable
		N: disable
		M: build as module
config AMLOGIC_TS2
	bool "Enable TS2"
	default n
	depends on AM_DVB
	help
		Enable TS2.
		Y: enable
		N: disable
		M: build as module
config AMLOGIC_S_TS2
	bool "Serial TS2"
	default n
	depends on AMLOGIC_TS2
	help
		TS2 in serial mode.
		Y: enable
		N: disable
		M: build as module
config AMLOGIC_TS2_INVERT_S2P1_FEC_ERROR
	bool "Invert FEC_ERROR TS2"
	default n
	depends on AMLOGIC_S_TS2
	help
		TS2 FEC_ERROR invert
		Y: enable
		N: disable
		M: build as module
config AMLOGIC_TS2_INVERT_S2P1_FEC_DATA
	bool "Invert FEC_DATA TS2"
	default n
	depends on AMLOGIC_S_TS2
	help
		TS2 FEC_DATA invert
		Y: enable
		N: disable
		M: build as module
config AMLOGIC_TS2_INVERT_S2P1_FEC_SYNC
	bool "Invert FEC_SYNC TS2"
	default n
	depends on AMLOGIC_S_TS2
	help
		TS2 FEC_SYNC invert
		Y: enable
		N: disable
		M: build as module
config AMLOGIC_TS2_INVERT_S2P1_FEC_VALID
	bool "Invert FEC_VALID TS2"
	default n
	depends on AMLOGIC_S_TS2
	help
		TS2 FEC_VALID invert
		Y: enable
		N: disable
		M: build as module
config AMLOGIC_TS2_INVERT_S2P1_FEC_CLK
	bool "Invert FEC_CLK TS2"
	default n
	depends on AMLOGIC_S_TS2
	help
		TS2 FEC_CLK invert
		Y: enable
		N: disable
		M: build as module
endif
source "drivers/amlogic/dvb_tv/smartcard/Kconfig"

config AM_SI2168
	tristate "SI2168 DVB-T2 demod driver"
	default n
	depends on AM_DVB
	help
		select the SI2168 DVB-T2 demod.
		Y: enable
		N: disable
		M: build as module

config AM_SI2151
	tristate "SI2151 tuner driver"
	default n
	depends on AM_DVB
	help
		select the SI2151 tuner.
		Y: enable
		N: disable
		M: build as module

config AM_ATV_SEARCH_PATCH
        tristate "Amlogic AVT search patch for abc123"
        default n
        help
                Modify AVT search patch for abc123
























endmenu
```

## kernel/amlogic/r311/drivers/amlogic/input/remote/Kconfig
```kconfig
#
# Remote control drivers
#
menuconfig AMLOGIC_REMOTE
	bool "GX Remotes"
	default n
	help
	  Say Y here, and a list of supported remote controls will be displayed.
	  This option doesn't affect the kernel.

	  If unsure, say Y.

if AMLOGIC_REMOTE

config MESON_REMOTE
	tristate "GX IR remote control support"
	default n
	help
	  Say Y here if you want to use the Meson IR remote control.



config MESON_REMOTE_LEARN
	tristate "GX IR learn support"
	depends on MESON_REMOTE
	default n
	help
	  Say Y here if you want to use the Meson IR learning.

config AM_WOL
	tristate "WOL support"
	default n
	help
	  Say Y here if you want to use WOL
endif # AMLOGIC_REMOTE
```

## kernel/amlogic/r311/drivers/amlogic/memory_ext/Kconfig
```kconfig
menuconfig AMLOGIC_MEMORY_EXTEND
	bool "AMLOGIC memory extend support"
	default y
	help
		Amlogic memory extend is drivers which extend for memory management
		functions, can be used for memory debug or other features.
		This is a gernal config for this Kconfig.

config AMLOGIC_PAGE_TRACE
	bool "Amlogic trace for page allocate"
	depends on AMLOGIC_MEMORY_EXTEND
	depends on KALLSYMS
	default y
	help
		Amlogic page trace will record function address of caller for page
		allocate/free, according with allocate flags and order. trace
		information is stored in a pre-allocated memory block. And can be shown
		with allocate page count information of each caller functions from
		/proc/pagetrace

config AMLOGIC_CMA
	bool "Amlogic CMA change"
	depends on AMLOGIC_MEMORY_EXTEND
	depends on CMA
	default y
	help
		Amlogic CMA optimization for cma alloc/free problems
		Including policy change of CMA usage

config AMLOGIC_MEM_PRE_WAKE_KSWAP
	bool "Amlogic pre wake kswapd"
	depends on AMLOGIC_MEMORY_EXTEND
	default y
	help
		Amlogic MM optimization. If many applications have large amount
		of memory allocation request in very shot time, wake up kswapd
		quickly before each allocate to avoid memory can't get problem
```

## kernel/amlogic/r311/drivers/amlogic/tvin/Kconfig
```kconfig
#
# Amlogic tvin devices configuration
#

comment "Amlogic TVIN Drivers"

menuconfig TVIN
        tristate "Amlogic TVIN support"
        default n
        help
                "Amlogic TVIN module driver"
config AM_CVBS_PAL_M
        tristate "Amlogi TVIN for PAL_M format"
        default n
        help
          "Amlogi TVIN for PAL_M format
                Y: enable
                N: disable
                M: build as module

config AM_TRY_FORMAT_MAX_AV
        tristate "Amlogic try format max for AV"
        default n
        help
            "Amlogic try format max for AV"
config AM_AV_CH_WHITE_PATTERN_EN
        boolean "Amlogic av ch_white pattern enable"
        default n
        help
            Enable av ch_white pattern if needed

if TVIN
source "drivers/amlogic/tvin/vdin/Kconfig"
source "drivers/amlogic/tvin/tvafe/Kconfig"
source "drivers/amlogic/tvin/hdmirx/Kconfig"
source "drivers/amlogic/tvin/hdmirx_ext/Kconfig"
source "drivers/amlogic/tvin/bt656/Kconfig"
#source "drivers/amlogic/tvin/csi/Kconfig"
source "drivers/amlogic/tvin/viu/Kconfig"
#source "drivers/amlogic/tvin/it660x/Kconfig"
source "drivers/amlogic/tvin/isp/Kconfig"
#source "drivers/amlogic/tvin/vdin_ctrl/Kconfig"
endif
```

## kernel/amlogic/r311/drivers/amlogic/tvin/hdmirx/Kconfig
```kconfig
#
# HDMI Rx Device Driver Configuration
#


config TVIN_HDMI
    tristate "Amlogic HDMI RX device driver"
    default n
    help
      HDMI RX device driver.
      HDMI RX device driver.
      HDMI RX device driver.
      HDMI RX device driver.

config TVIN_HDMI_CEC
    tristate "Amlogic HDMI RX CEC device driver"
    depends on TVIN_HDMI
    default n
    help
      HDMI RX CEC device driver.

config AM_HDMI_SCAN_MODE_NODE
    tristate "Amlogic HDMI increase the scan_mode node"
    default n
    help
      HDMI increase the scan_mode node.

config AM_HDMI_AUDIO_FIFO
    tristate "Amlogic HDMIRX optimize for audio fifo"
    default n
    help
      HDMIRX optimize for audio fifo.
```

## kernel/amlogic/r311/drivers/amlogic/tvin/tvafe/Kconfig
```kconfig
#
# AMLOGIC TVAFE Device Driver Configuration
#

config TVIN_AFE
	tristate "Amlogic AFE device driver"
	default n
	help
		AFE device driver,
		process input source of av/atv/vga/ypbpr/atvdemod,
		translate analog signal to digtal to vdin process

if TVIN_AFE
config ADC_DOUBLE_SAMPLING_FOR_SD
	bool "Enable double sampling function"
	default n
	help
		Adc double sampling for SD
		only for input source of Component,
		and only for Standard Definition input
		to use

config ADC_DOUBLE_SAMPLING_FOR_CVBS
	bool "Enable double sampling function for AV port"
	default n
	help
		Adc double sampling for AV port
		Only for input source of AV,
		Only support on G9TV and after G9TV
		right now,not add support on M6TV

config TVIN_VBI
	tristate "Amlogic TVIN VBI device"
	default n
	help
		VBI devices driver
		Only for ATV input,
		By now,wo only test CC is ok on M6TV & G9TV
		CC is usually used in USA
config TVIN_AVIN_DETECT
	tristate "Amlogic AVIN DETECT device"
	default n
	help
		avin detect devices driver
		Only for av input
endif

config AM_PRODUCT_ANJALI
	tristate "ANJALI devices"
	default n
	help
		only use for anjali

config AM_ATV_SYNC_SCAN_RANGE
        tristate "Amlogic ATV sync scan range adjust"
        default n
        help
                Adjust Hsync and Vsync scan range

config AM_VLOCK_MODE
	tristate "Amlogic vlock mode adjust"
	default n
	help
		Adjust vlock mode
config AM_ATV_SEARCH_RANGE
        tristate "Amlogic ATV search range"
        default n
        help
                reduce ATV search limit

config AM_AV_SECAM_CVD2
        tristate "Amlogic AV SECAM CVD2 Modify color bar inch color"
        default n
        help
                Modify color bar inch color

config AM_ATV_CHANGE_SCREEN_SIZE
        tristate "Amlogic atv screen ratio is abnormal after switch channel sometimes"
        default n
        help
               Modify AVT change screen size after dec start if needed

config AM_AV_ADD_CHROME_LOCK_DETECT
	boolean "Amlogic av chrome lock detect"
	default n
	help
		Detect chroma lock detect if needed
```

## kernel/amlogic/t950x4/4.9/drivers/amlogic/bl30msg/Kconfig
```kconfig
#
#   AMLOGIC bl30msg configuration
#
menu "AMLOGIC BL30MSG process"

config AMLOGIC_BL30MSG
	bool "MESON based bl30 log show"
	default n
	help
		This driver show logs of bl30 and bl301 stored
		in a ring buffer shared between kernel and bl30

endmenu
```

## kernel/amlogic/t950x4/4.9/drivers/amlogic/ethernet/phy/Kconfig
```kconfig
#
# PHY Layer Configuration
#

config AMLOGIC_INTERNAL_PHY
	tristate "Drivers for amlogic internal phy"
	---help---
	  Currently supports the amlogic internal phy.
	  This module implements the amlogic internal phy,
	  modify the dts file to switch internal external phy.

	  if in doube, ask yizhou.

config WOL_POWER
	bool "Enable or disable wol power control"
	default y
	help
		if enable WOL_POWER config, will create /proc/wol_enable node.
		use the node to control wol power pin

config ENABLE_WOL_THR_UI
	bool "Enable or disable wol by ui control"
	default n
	help
		if enable WOL_THR_UI, this function will control by UI
```

## kernel/amlogic/t950x4/4.9/drivers/amlogic/media/dtv_demod_v3/Kconfig
```kconfig
#
# DTV driver configuration
#

menu "Amlogic DTV driver"

config AMLOGIC_DTV_DEMOD_V3
	tristate "Amlogic DTVDEMOD V3 device driver"
	default n
	help
		DTVDEMOD device driver.
		Y: enable
		N: disable
		M: build as module

endmenu
```

## kernel/amlogic/t950x4/4.9/drivers/amlogic/media/enhancement/amvecm/Kconfig
```kconfig
#
# AMLOGIC amvecm devices configuration
#

comment "Amlogic VECM Drivers"

menu "Amlogic amvecm Driver"

config AMLOGIC_MEDIA_ENHANCEMENT_VECM
        bool "Amlogic amvecm driver"
        default n
        help
            "Amlogic amvecm module init"

config AMLOGIC_MEDIA_HDR_V1
        bool "Amlogic HDR algorithm V1"
        default n
        help
            "Amlogic HDR algorithm V1"

endmenu
```

## kernel/amlogic/t950x4/4.9/drivers/amlogic/media/vin/adc_v3/Kconfig
```kconfig
#
# ADC Device Driver Configuration
#
config AMLOGIC_MEDIA_ADC
        tristate "Amlogic ADC V3 device driver"
        default n
        help
            ADC device driver.
```

## kernel/amlogic/t950x4/4.9/drivers/amlogic/media/vout/vdac/Kconfig
```kconfig
#
# Video output configuration
#

config AMLOGIC_VDAC
	bool "VDAC Module"
	default n
	help
		VDAC config.

config DISABLE_CVBSOUT
        bool "DISABLE_CVBSOUT"
        default n
        help
                DISABLE_CVBSOUT.
```
