## bootable/bootloader/uboot-amlogic/t950x4/bl33/board/amlogic/almond/Kconfig
```kconfig
if TARGET_MESON_T5D

config SYS_CPU
	string
	default "armv8"

config SYS_BOARD
	string
	default "almond"

config SYS_VENDOR
	string
	default "amlogic"

config SYS_SOC
	string
	default "t5d"

config SYS_CONFIG_NAME
	default "almond"

config BL30_SELECT
	string "T5D BL30 board config"
	default "t5d_am301_v1"

config MTK_BT_USB
    bool "enable mtk bt usb function"
    default n
    help
        select this item will enable mtk bt usb device

endif
```

## bootable/bootloader/uboot-amlogic/t950x4/bl33/board/amlogic/defconfigs/dahlia_defconfig
```kconfig
CONFIG_ARM=y
CONFIG_TARGET_MESON_T5D=y
CONFIG_DAHLIA=y
CONFIG_DM=y
CONFIG_DM_GPIO=y
CONFIG_AML_GPIO=y
CONFIG_MTK_BT_USB=y
```

## bootable/bootloader/uboot-amlogic/t950x4/bl33/configs/glacier_defconfig
```kconfig
CONFIG_SYS_EXTRA_OPTIONS="aBc123"
CONFIG_PPC=y
CONFIG_4xx=y
CONFIG_TARGET_CANYONLANDS=y
```

## bootable/bootloader/uboot-amlogic_r311/board/amlogic/blanche/Kconfig
```kconfig
if TARGET_MESON_TXLX

config SYS_CPU
	string
	default "armv8"

config SYS_BOARD
	string
	default "blanche"

config SYS_VENDOR
	string
	default "amlogic"

config SYS_SOC
	string
	default "txlx"

config SYS_CONFIG_NAME
	default "blanche"

config MTK_BT_USB
    bool "enable mtk bt usb function"
    default n
    help
        select this item will enable mtk bt usb device

config AMZN_SILENT_OTA
    bool "enable silent OTA"
    default n
    help
        select this item will enable Amazon Silent OTA

endif
```

## kernel/amlogic/r311/arch/arm/mach-meson/Kconfig
```kconfig
config ARCH_MESON
	bool "Amlogic Meson SoCs" if ARCH_MULTI_V7
	select GENERIC_IRQ_CHIP
	select ARM_GIC
	select CPU_V7
	select FIQ
	select USE_OF
	select GENERIC_ALLOCATOR
	select GENERIC_CLOCKEVENTS
	select ARCH_HAS_CPUFREQ
	select MIGHT_HAVE_CACHE_L2X0
	select HAVE_SMP
	select ARM_PSCI
	select HAVE_ARM_SCU
	select SPARSE_IRQ
	select ARCH_HAS_RESET_CONTROLLER
	select REGMAP_MMIO

if ARCH_MESON

menu "Amlogic Chip type"

config ARM64_32
	tristate "ARMV8 Run in A32"
	default n
    select ARCH_HAS_OPP
	help
	  amlogic armv8 chip support 32bit.
endmenu
endif
```
